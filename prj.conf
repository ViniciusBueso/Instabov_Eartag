## CMakeLists.txt
```
cmake_minimum_required(VERSION 3.20.0)
find_package(Zephyr REQUIRED HINTS $ENV{ZEPHYR_BASE})

project(Instabov_Eartag)

target_sources(app PRIVATE 
    src/main.c
    src/ble/ble_adv.c
    src/peripherals/my_gpio.c
    src/peripherals/my_adc.c
    src/peripherals/my_temp.c
    src/libraries/fuel_gauge_cr2430.c
)
```

## prj.conf
```kconfig
#Enable Printk
CONFIG_PRINTK=y

#Enable GPIOs
CONFIG_GPIO=y

#Include the Bluetooth LE stack
CONFIG_BT=y

#Config device as peripheral
CONFIG_BT_PERIPHERAL=y

#Enable extended advertising w/ coded PHY (S=8)
CONFIG_BT_EXT_ADV=y
CONFIG_BT_CTLR_PHY_CODED=y
CONFIG_BT_EXT_ADV_CODING_SELECTION=y

#Enable dynamic TX power control
CONFIG_BT_CTLR_CONN_RSSI=y
CONFIG_BT_CTLR_TX_PWR_DYNAMIC_CONTROL=y

# Increase stack size for the main thread and System Workqueue
CONFIG_SYSTEM_WORKQUEUE_STACK_SIZE=2048
CONFIG_MAIN_STACK_SIZE=2048
CONFIG_BT_RX_STACK_SIZE=2048

#Enable ADC drivers
CONFIG_ADC=y

#Enable bare-metal temp peripheral driver
CONFIG_NRFX_TEMP=y

#Enable float-point support
CONFIG_FPU=y

#Enable fuel gauge library
CONFIG_NRF_FUEL_GAUGE=y
CONFIG_NRF_FUEL_GAUGE_VARIANT_PRIMARY_CELL=y
```

## nrf54l15dk_nrf54l15_cpuapp.overlay
```dts
// To get started, press Ctrl+Space to bring up the completion menu and view the available nodes.

// You can also use the buttons in the sidebar to perform actions on nodes.
// Actions currently available include:

// * Enabling / disabling the node
// * Adding the bus to a bus
// * Removing the node
// * Connecting ADC channels

// For more help, browse the DeviceTree documentation at https://docs.zephyrproject.org/latest/guides/dts/index.html
// You can also visit the nRF DeviceTree extension documentation at https://docs.nordicsemi.com/bundle/nrf-connect-vscode/page/guides/ncs_configure_app.html#devicetree-support-in-the-extension
/ {
	zephyr,user {
		io-channels = <&adc 0>;
	};
};

&adc {
	#address-cells = <1>;
	#size-cells = <0>;
	status = "okay";
	channel@0 {
		reg = <0>;
		zephyr,gain = "ADC_GAIN_1_4";
		zephyr,reference = "ADC_REF_INTERNAL";
		zephyr,acquisition-time = <ADC_ACQ_TIME_DEFAULT>;
		zephyr,input-positive = <NRF_SAADC_VDD>; 
		zephyr,resolution = <14>;
	};
};
```

## src/main.c
```c
#include <zephyr/kernel.h>
#include "ble/ble_adv.h"
#include "peripherals/my_gpio.h"
#include "peripherals/my_adc.h"
#include <zephyr/bluetooth/uuid.h>
#include <zephyr/bluetooth/bluetooth.h>
#include <zephyr/bluetooth/addr.h>
#include <hal/nrf_ficr.h>
#include <zephyr/bluetooth/hci_vs.h>
#include <zephyr/bluetooth/hci.h>
#include <zephyr/sys/byteorder.h>
#include "peripherals/my_temp.h"
#include "libraries/fuel_gauge_cr2430.h"

int err;
volatile uint32_t test_steps=0;
volatile uint8_t test_bat=0;
volatile uint32_t dev_id0, dev_id1, addr0, addr1;
volatile uint8_t addr_type;

typedef union{
    struct{
        uint32_t addr0;
        uint32_t addr1;
    }__attribute__((packed)) fields32;
    char byte_val[8];
}__attribute__((packed)) addr_ble_type;

void set_BLE_rnd_addr_from_FICR(bt_addr_le_t *addr);
static void set_tx_power(uint8_t handle_type, uint16_t handle, int8_t tx_pwr_lvl);

bt_addr_le_t addr; //variável que guarda o endereço ble

int main(void)
{
    //Read unique device ID
    dev_id0 = nrf_ficr_deviceid_get(NRF_FICR, 0);
    dev_id1 = nrf_ficr_deviceid_get(NRF_FICR, 1);
    
    //Set BLE address from FICR register
    set_BLE_rnd_addr_from_FICR(&addr);

    //Initialize temperature sensor
    err = init_temp_peripheral();
    if(err!=NRFX_SUCCESS){
        printk("temp error\r\n");
    }
    
    //Initialize ADC
    err  = adc_initialize();   
    printk("err0=%d\r\n", err);   
    
    //Register the address as Identity Address
	err = bt_id_create(&addr, NULL);
    printk("err1=%d\r\n", err);

    /* Initialize the Bluetooth Subsystem */
	err = bt_enable(NULL);
    printk("err2=%d\r\n", err);

    //Configure advertising procedure and packet (Extended with CODED PHY [S=8])
    err = configure_ext_adv();
    printk("err3=%d\r\n", err);

    //Start advertising procedure
    err = bt_le_ext_adv_start(adv, BT_LE_EXT_ADV_START_DEFAULT);
    printk("err4=%d\r\n", err);

    //Configure TX power
    set_tx_power(BT_HCI_VS_LL_HANDLE_TYPE_ADV, 0, 7);

    //Initialize fuel gauge to estimate battery lvl
    err = fuel_gauge_init(BATTERY_TYPE_LITHIUM_CR2032);

    while(1){
        test_steps++;
        err = fuel_gauge_update(&state_of_charge);       
        err = update_adv_custom_data(test_steps, (uint8_t)state_of_charge); 
        printk("SOC = %.2f%%     \r", state_of_charge);

        k_sleep(K_MSEC(1000));
    }
    return 0;
}


void set_BLE_rnd_addr_from_FICR(bt_addr_le_t *addr){
    addr_ble_type addr_ble;
    addr_ble.fields32.addr0 = nrf_ficr_deviceaddr_get(NRF_FICR, 0);
    addr_ble.fields32.addr1 = nrf_ficr_deviceaddr_get(NRF_FICR, 1);
    addr_ble.byte_val[5] = addr_ble.byte_val[5] | 0xC0;
    for(uint8_t idx = 0; idx<6; idx++){
        addr->a.val[idx] = addr_ble.byte_val[idx];
    }
    addr->type = BT_ADDR_LE_RANDOM;

}


static void set_tx_power(uint8_t handle_type, uint16_t handle, int8_t tx_pwr_lvl)
{
	struct bt_hci_cp_vs_write_tx_power_level *cp;
	struct bt_hci_rp_vs_write_tx_power_level *rp;
	struct net_buf *buf, *rsp = NULL;
	int err;

	buf = bt_hci_cmd_create(BT_HCI_OP_VS_WRITE_TX_POWER_LEVEL,
				sizeof(*cp));
	if (!buf) {
		printk("Unable to allocate command buffer\n");
		return;
	}

	cp = net_buf_add(buf, sizeof(*cp));
	cp->handle = sys_cpu_to_le16(handle);
	cp->handle_type = handle_type;
	cp->tx_power_level = tx_pwr_lvl;

	err = bt_hci_cmd_send_sync(BT_HCI_OP_VS_WRITE_TX_POWER_LEVEL,
				   buf, &rsp);
	if (err) {
		printk("Set Tx power err: %d\n", err);
		return;
	}

	rp = (void *)rsp->data;
	printk("Actual Tx Power: %d\n", rp->selected_tx_power);

	net_buf_unref(rsp);
}
```
